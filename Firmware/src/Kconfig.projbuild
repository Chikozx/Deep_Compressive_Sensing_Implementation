## Firmware/src/Kconfig.projbuild
```kconfig
menu "SPP Configuration"
    config SSP_ENABLED
        bool "Secure Simple Pairing"
        depends on BT_CLASSIC_ENABLED
        default y
        help
            This enables the Secure Simple Pairing. If disable this option,
            Bluedroid will only support Legacy Pairing

    config LOCAL_DEVICE_NAME
        string "Local Device Name"
        default "ESP_SPP_ACCEPTOR"
        help
            Use this option to set local device name.
endmenu
```
